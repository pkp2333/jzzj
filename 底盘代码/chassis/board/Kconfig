## 底盘代码/chassis/board/Kconfig
```kconfig
menu "Hardware Drivers Config"

config SOC_STM32F407IG
    bool
    select SOC_SERIES_STM32F4
    select RT_USING_COMPONENTS_INIT
    select RT_USING_USER_MAIN
    default y

menu "Onboard Peripheral Drivers"

    config BSP_USING_RS232_TO_USART
        bool "Enable RS232 TO USART (uart1)"
        select BSP_USING_UART
        select BSP_USING_UART1
        default n
		
	config BSP_USING_SPI_FLASH
        bool "Enable SPI FLASH (W25Q64 spi3)"
        select BSP_USING_SPI
        select BSP_USING_SPI3
        select RT_USING_SFUD
        select RT_SFUD_USING_SFDP
        default n

    config BSP_USING_SDCARD
        bool "Enable SDCARD (sdio)"
        select BSP_USING_SDIO
        select RT_USING_DFS
        select RT_USING_DFS_ELMFAT
        default n

    config BSP_USING_MPU6050
        bool "Enable MPU6050(i2c2)"
        select BSP_USING_I2C2
        select PKG_USING_SENSORS_DRIVERS
        select PKG_USING_MPU6XXX
        select PKG_USING_MPU6XXX_SAMPLE
        select PKG_USING_MPU6XXX_LATEST_VERSION
        default n

endmenu

menu "On-chip Peripheral Drivers"

    config BSP_USING_GPIO
        bool "Enable GPIO"
        select RT_USING_PIN
        default y

    menuconfig BSP_USING_UART
        bool "Enable UART"
        default y
        select RT_USING_SERIAL
        if BSP_USING_UART
            config BSP_USING_UART1
                bool "Enable UART1"
                default n

            config BSP_UART1_RX_USING_DMA
                bool "Enable UART1 RX DMA"
                depends on BSP_USING_UART1 && RT_SERIAL_USING_DMA
                default n

            config BSP_USING_UART2
                bool "Enable UART2"
                default n

            config BSP_UART2_RX_USING_DMA
                bool "Enable UART2 RX DMA"
                depends on BSP_USING_UART2 && RT_SERIAL_USING_DMA
                default n
				
			config BSP_USING_UART3
                bool "Enable UART3"
                default n

            config BSP_UART3_RX_USING_DMA
                bool "Enable UART3 RX DMA"
                depends on BSP_USING_UART3 && RT_SERIAL_USING_DMA
                default n	
			
			config BSP_USING_UART4
                bool "Enable UART4"
                default n

            config BSP_UART4_RX_USING_DMA
                bool "Enable UART4 RX DMA"
                depends on BSP_USING_UART4 && RT_SERIAL_USING_DMA
                default n

        endif
        
    config BSP_USING_ON_CHIP_FLASH
        bool "Enable on-chip FLASH"
        default n

    menuconfig BSP_USING_SPI
        bool "Enable SPI BUS"
        default n
        select RT_USING_SPI
        if BSP_USING_SPI
            config BSP_USING_SPI3
                bool "Enable SPI3 BUS"
                default n

            config BSP_SPI3_TX_USING_DMA
                bool "Enable SPI3 TX DMA"
                depends on BSP_USING_SPI3
                default n
                
            config BSP_SPI3_RX_USING_DMA
                bool "Enable SPI3 RX DMA"
                depends on BSP_USING_SPI3
                select BSP_SPI3_TX_USING_DMA
                default n
        endif

    menuconfig BSP_USING_I2C2
        bool "Enable I2C2 BUS (software simulation)"
        default n
        select RT_USING_I2C
        select RT_USING_I2C_BITOPS
        select RT_USING_PIN
        if BSP_USING_I2C2
            comment "Notice: PH4 --> 116; PH5 --> 117"
            config BSP_I2C2_SCL_PIN
                int "i2c2 scl pin number"
                range 1 143
                default 116
            config BSP_I2C2_SDA_PIN
                int "I2C2 sda pin number"
                range 1 143
                default 117
        endif

    menuconfig BSP_USING_TIM
        bool "Enable timer"
        default n
        select RT_USING_HWTIMER
        if BSP_USING_TIM
            config BSP_USING_TIM11
                bool "Enable TIM11"
                default n

            config BSP_USING_TIM13
                bool "Enable TIM13"
                default n

            config BSP_USING_TIM14
                bool "Enable TIM14"
                default n
        endif

    menuconfig BSP_USING_PWM
        bool "Enable PWM"
        default n
        select RT_USING_PWM
        if BSP_USING_PWM
        menuconfig BSP_USING_PWM1
            bool "Enable timer1 output PWM"
            default n
            if BSP_USING_PWM1
                config BSP_USING_PWM1_CH1
                    bool "Enable PWM1 channel1"
                    default n
				config BSP_USING_PWM1_CH2
                    bool "Enable PWM1 channel2"
                    default n
				config BSP_USING_PWM1_CH3
                    bool "Enable PWM1 channel3"
                    default n
				config BSP_USING_PWM1_CH4
                    bool "Enable PWM1 channel4"
                    default n
            endif
			
		menuconfig BSP_USING_PWM8
            bool "Enable timer8 output PWM"
            default n
            if BSP_USING_PWM8
                config BSP_USING_PWM8_CH1
                    bool "Enable PWM8 channel1"
                    default n
				config BSP_USING_PWM8_CH2
                    bool "Enable PWM8 channel2"
                    default n
				config BSP_USING_PWM8_CH3
                    bool "Enable PWM8 channel3"
                    default n
				config BSP_USING_PWM8_CH4
                    bool "Enable PWM8 channel4"
                    default n
            endif

		menuconfig BSP_USING_PWM9
            bool "Enable timer9 output PWM"
            default n
            if BSP_USING_PWM9
                config BSP_USING_PWM9_CH1
                    bool "Enable PWM9 channel1"
                    default n
				config BSP_USING_PWM9_CH2
                    bool "Enable PWM9 channel2"
                    default n
				config BSP_USING_PWM9_CH3
                    bool "Enable PWM9 channel3"
                    default n
				config BSP_USING_PWM9_CH4
                    bool "Enable PWM9 channel4"
                    default n
            endif
		
		menuconfig BSP_USING_PWM10
            bool "Enable timer10 output PWM"
            default n
            if BSP_USING_PWM10
                config BSP_USING_PWM10_CH1
                    bool "Enable PWM10 channel1"
                    default n
				config BSP_USING_PWM10_CH2
                    bool "Enable PWM10 channel2"
                    default n
				config BSP_USING_PWM10_CH3
                    bool "Enable PWM10 channel3"
                    default n
				config BSP_USING_PWM10_CH4
                    bool "Enable PWM10 channel4"
                    default n
            endif
		
		menuconfig BSP_USING_PWM11
            bool "Enable timer11 output PWM"
            default n
            if BSP_USING_PWM11
                config BSP_USING_PWM11_CH1
                    bool "Enable PWM11 channel1"
                    default n
				config BSP_USING_PWM11_CH2
                    bool "Enable PWM11 channel2"
                    default n
				config BSP_USING_PWM11_CH3
                    bool "Enable PWM11 channel3"
                    default n
				config BSP_USING_PWM11_CH4
                    bool "Enable PWM11 channel4"
                    default n
            endif
        endif
		
	menuconfig BSP_USING_ADC
		bool "Enable ADC"
		default n
		select RT_USING_ADC
		if BSP_USING_ADC
			config BSP_USING_ADC1
				bool "Enable ADC1"
				default n
			config BSP_USING_ADC2
				bool "Enable ADC2"
				default n
			config BSP_USING_ADC2
				bool "Enable ADC2"
				default n
		endif

    config BSP_USING_WDT
        bool "Enable Watchdog Timer"
        select RT_USING_WDT
        default n

    config BSP_USING_SDIO
        bool "Enable SDIO"
        select RT_USING_SDIO
        select RT_USING_DFS
        default n

    source "libraries/HAL_Drivers/Kconfig"
    
endmenu

menu "Board extended module Drivers"

endmenu
 
endmenu
```
